## Kconfig
```kconfig
config USR_DRV_CAN
  bool  "Userspace CAN driver"
  default n
  ---help---
  Support for STM32F4 CAN hardware IP.


if USR_DRV_CAN

menu "Userspace CAN driver options"

choice
  prompt "Kind of CAN bus targeted"
  config CAN_TARGET_VEHICLES
    bool "Support for CAN buses on vehicles"
    help
      Select the bit rate configuration adapted to a CAN bus in a vehicle.
  config CAN_TARGET_AUTOMATONS
    bool "Support for CAN buses on industrial automation systems"
    help
      Select the bit rate configuration adapted to a CAN bus in a industrial automaton.
endchoice

config APB1_DIVISOR
   int "APB1 bus divisor"
   range 1 5
   default 4
   help
      Specify the APB1 Bus clock divisor


config USR_DRV_CAN_DEBUG
  bool "Activate CAN driver debugging"
  default n
  ---help---
    Pretty print various events and data handled by the CAN driver
    on the kernel serial interface

endmenu

endif
```
